## config/west.yml
```yaml
manifest:
  remotes:
    - name: zmkfirmware
      url-base: https://github.com/zmkfirmware
    - name: ergonautkb
      url-base: https://github.com/ergonautkb
  projects:
    - name: zmk
      remote: zmkfirmware
      revision: v0.2-branch
      import: app/west.yml
  self:
    path: config
```
